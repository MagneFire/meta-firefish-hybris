## conf/layer.conf
```bitbake
BBPATH .= ":${LAYERDIR}"
BBFILES += "${LAYERDIR}/recipes*/*/*.bb ${LAYERDIR}/recipes*/*/*.bbappend"
BBFILE_COLLECTIONS += "firefish-hybris-layer"
BBFILE_PATTERN_firefish-hybris-layer := "^${LAYERDIR}/"
BBFILE_PRIORITY_firefish-hybris-layer = "8"
LAYERSERIES_COMPAT_firefish-hybris-layer = "hardknott"
```
